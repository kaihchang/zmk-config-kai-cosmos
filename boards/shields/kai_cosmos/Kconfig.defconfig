## boards/shields/kai_cosmos/Kconfig.defconfig
```kconfig
if SHIELD_COSMOS_RIGHT

config ZMK_KEYBOARD_NAME
    default "Cosmos ZMK"

config ZMK_SPLIT_BLE_ROLE_CENTRAL
    default y

endif

if SHIELD_COSMOS_LEFT || SHIELD_COSMOS_RIGHT

config ZMK_SPLIT
    default y

endif
```

## boards/shields/kai_cosmos/Kconfig.shield
```kconfig
config SHIELD_COSMOS_LEFT
    def_bool $(shields_list_contains,cosmos_left)

config SHIELD_COSMOS_RIGHT
    def_bool $(shields_list_contains,cosmos_right)
```
