#include "cosmos.dtsi"

/ {
    chosen {
        zmk,kscan = &mock_kscan;
    };

    mock_kscan: kscan_1 {
        compatible = "zmk,kscan-mock";
        columns = <0>;
        rows = <0>;
        events = <0>;
    };
};

/ {
	input_relay_config_trackball {
		compatible = "zmk,split-peripheral-input-relay";
		device = <&vtrackball>;
		relay-channel = <102>;
	};
};